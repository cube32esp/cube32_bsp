## examples/hello_display/sdkconfig.defaults.esp32s3
```kconfig
# CUBE32 sdkconfig.defaults.esp32s3 — ESP32-S3 specific settings
# Applied after sdkconfig.defaults when target is esp32s3.

# ---------------------------------------------------------------------------
# Flash
# ---------------------------------------------------------------------------
CONFIG_ESPTOOLPY_FLASHSIZE_16MB=y
CONFIG_ESPTOOLPY_FLASHMODE_QIO=y

# ---------------------------------------------------------------------------
# CPU
# ---------------------------------------------------------------------------
CONFIG_ESP_DEFAULT_CPU_FREQ_MHZ_240=y

# ---------------------------------------------------------------------------
# PSRAM — Octal SPI RAM (8 MB on CUBE32-S3 Core)
# ---------------------------------------------------------------------------
CONFIG_SPIRAM=y
CONFIG_SPIRAM_MODE_OCT=y
CONFIG_SPIRAM_SPEED_80M=y
CONFIG_SPIRAM_MALLOC_ALWAYSINTERNAL=512
CONFIG_SPIRAM_MALLOC_RESERVE_INTERNAL=65536
CONFIG_SPIRAM_MEMTEST=n

# ---------------------------------------------------------------------------
# Cache — larger instruction cache improves PSRAM throughput
# ---------------------------------------------------------------------------
CONFIG_ESP32S3_INSTRUCTION_CACHE_32KB=y
CONFIG_ESP32S3_DATA_CACHE_LINE_64B=y

# ---------------------------------------------------------------------------
# System event task — reduce stack
# ---------------------------------------------------------------------------
CONFIG_ESP_SYSTEM_EVENT_TASK_STACK_SIZE=4096
```

## examples/hello_world/sdkconfig.defaults
```kconfig
# CUBE32 sdkconfig.defaults — hello_world
# Applied first by ESP-IDF; target-specific overrides go in sdkconfig.defaults.<target>

# ---------------------------------------------------------------------------
# [ALWAYS ON] Compiler
# ---------------------------------------------------------------------------
CONFIG_COMPILER_OPTIMIZATION_SIZE=y
CONFIG_COMPILER_CXX_EXCEPTIONS=y
CONFIG_COMPILER_CXX_EXCEPTIONS_EMG_POOL_SIZE=1024
CONFIG_COMPILER_CXX_RTTI=y

# ---------------------------------------------------------------------------
# [ALWAYS ON] Bootloader
# ---------------------------------------------------------------------------
CONFIG_BOOTLOADER_COMPILER_OPTIMIZATION_PERF=y
CONFIG_BOOTLOADER_LOG_LEVEL_NONE=y
CONFIG_BOOTLOADER_SKIP_VALIDATE_ALWAYS=y
CONFIG_BOOTLOADER_APP_ROLLBACK_ENABLE=y

# ---------------------------------------------------------------------------
# [ALWAYS ON] Partition table — standard CUBE32 16 MB layout
# ---------------------------------------------------------------------------
CONFIG_PARTITION_TABLE_CUSTOM=y
CONFIG_PARTITION_TABLE_CUSTOM_FILENAME="partitions/partitions.csv"
CONFIG_PARTITION_TABLE_OFFSET=0x8000

# ---------------------------------------------------------------------------
# [ALWAYS ON] FreeRTOS
# ---------------------------------------------------------------------------
CONFIG_ESP_TASK_WDT_TIMEOUT_S=10
CONFIG_FREERTOS_GENERATE_RUN_TIME_STATS=y
CONFIG_FREERTOS_USE_STATS_FORMATTING_FUNCTIONS=y
CONFIG_ESP_MAIN_TASK_STACK_SIZE=8192

# ---------------------------------------------------------------------------
# [ALWAYS ON] Newlib — smaller footprint
# ---------------------------------------------------------------------------
CONFIG_NEWLIB_NANO_FORMAT=y

# ---------------------------------------------------------------------------
# [ALWAYS ON] UART ISR in IRAM — prevents UART FIFO overflow during flash
# ---------------------------------------------------------------------------
CONFIG_UART_ISR_IN_IRAM=y

# ---------------------------------------------------------------------------
# CUBE32 Board — always required
# ---------------------------------------------------------------------------
CONFIG_CUBE32_BOARD_S3_CORE=y

# ---------------------------------------------------------------------------
# CUBE32 Subsystems
# ---------------------------------------------------------------------------
CONFIG_CUBE32_DISPLAY_ENABLED=y
CONFIG_CUBE32_DISPLAY_CUBE_TFT_TOUCH_154=y

CONFIG_CUBE32_LVGL_ENABLED=y
CONFIG_CUBE32_TOUCH_ENABLED=y
CONFIG_CUBE32_IMU_ENABLED=y
CONFIG_CUBE32_MAG_ENABLED=y
CONFIG_CUBE32_AUDIO_ENABLED=y
CONFIG_CUBE32_SDCARD_ENABLED=y
CONFIG_CUBE32_CAMERA_ENABLED=y
CONFIG_CUBE32_MODEM_ENABLED=y
CONFIG_CUBE32_PMU_ENABLED=y
CONFIG_CUBE32_BLE_OTA_ENABLED=y

# ---------------------------------------------------------------------------
# Camera
# ---------------------------------------------------------------------------
CONFIG_CAMERA_NO_AFFINITY=y
CONFIG_CAMERA_DMA_BUFFER_SIZE_MAX=32768

# ---------------------------------------------------------------------------
# Audio codec I2C
# ---------------------------------------------------------------------------
CONFIG_CODEC_I2C_BACKWARD_COMPATIBLE=n

# ---------------------------------------------------------------------------
# Modem — ESP modem + PPP + USB Host for A7670
# WARNING: TinyUSB (USB Device) MUST be disabled — it conflicts with USB Host
# ---------------------------------------------------------------------------
CONFIG_ESP_MODEM_ADD_FLOW_CONTROL=y
CONFIG_ESP_MODEM_CMUX_DEFRAGMENT_PAYLOAD=y
CONFIG_ESP_MODEM_PPP_SERVER_SUPPORT=y

# PPP stack support
CONFIG_PPP_SUPPORT=y
CONFIG_PPP_PAP_SUPPORT=y
CONFIG_PPP_CHAP_SUPPORT=y
CONFIG_PPP_MSCHAP_SUPPORT=y
CONFIG_PPP_MPPE_SUPPORT=y

# USB Host for A7670 modem
CONFIG_TINYUSB_ENABLED=n
CONFIG_USB_OTG_SUPPORTED=y
CONFIG_USB_HOST_CONTROL_TRANSFER_MAX_SIZE=1024
CONFIG_USB_HOST_HW_BUFFER_BIAS_BALANCED=y

# ---------------------------------------------------------------------------
# [ALWAYS ON] Bluetooth — NimBLE required by CUBE32_BLE_OTA_ENABLED
# ---------------------------------------------------------------------------
CONFIG_BT_ENABLED=y
CONFIG_BT_NIMBLE_ENABLED=y
CONFIG_BT_NIMBLE_ROLE_PERIPHERAL=y
CONFIG_BT_NIMBLE_ROLE_BROADCASTER=y
CONFIG_BT_NIMBLE_MAX_CONNECTIONS=1
CONFIG_BT_NIMBLE_MEM_ALLOC_MODE_INTERNAL=y
# BLE OTA speed optimisation — larger MTU/ACL/buffers for faster mobile transfer
CONFIG_BT_NIMBLE_ATT_PREFERRED_MTU=512
CONFIG_BT_NIMBLE_TRANSPORT_ACL_SIZE=512
CONFIG_BT_NIMBLE_MSYS_1_BLOCK_COUNT=24
CONFIG_BT_NIMBLE_MSYS_2_BLOCK_COUNT=32

# ---------------------------------------------------------------------------
# LVGL 9.x — tuned for hello_world (240×240, 3D cube + status screen)
# Fonts: montserrat_14 (hints/grid), montserrat_20 (status title),
#        montserrat_24 (splash title)
# ---------------------------------------------------------------------------
CONFIG_LV_OS_NONE=y
CONFIG_LV_USE_CLIB_MALLOC=y
CONFIG_LV_USE_CLIB_STRING=y
CONFIG_LV_USE_CLIB_SPRINTF=y
CONFIG_LV_USE_IMGFONT=y
CONFIG_LV_USE_ASSERT_STYLE=y
CONFIG_LV_FONT_FMT_TXT_LARGE=y
CONFIG_LV_USE_FONT_COMPRESSED=n
CONFIG_LV_USE_FONT_PLACEHOLDER=n
CONFIG_LV_FONT_MONTSERRAT_14=y
CONFIG_LV_FONT_MONTSERRAT_10=y
CONFIG_LV_FONT_MONTSERRAT_20=y
CONFIG_LV_FONT_MONTSERRAT_24=y
CONFIG_LV_USE_LODEPNG=y

# Disable unused widgets to save flash
CONFIG_LV_USE_ANIMIMG=n
CONFIG_LV_USE_CALENDAR=n
CONFIG_LV_USE_CALENDAR_HEADER_ARROW=n
CONFIG_LV_USE_CALENDAR_HEADER_DROPDOWN=n
CONFIG_LV_USE_CHART=n
CONFIG_LV_USE_KEYBOARD=n
CONFIG_LV_USE_LED=n
CONFIG_LV_USE_LIST=n
CONFIG_LV_USE_MENU=n
CONFIG_LV_USE_MSGBOX=n
CONFIG_LV_USE_SPAN=n
CONFIG_LV_USE_SPINBOX=n
CONFIG_LV_USE_SPINNER=n
CONFIG_LV_USE_TABVIEW=n
CONFIG_LV_USE_TILEVIEW=n
CONFIG_LV_USE_WIN=n
CONFIG_LV_BUILD_EXAMPLES=n
```

## examples/hello_world/sdkconfig.defaults.esp32s3
```kconfig
# CUBE32 sdkconfig.defaults.esp32s3 — ESP32-S3 specific settings
# Applied after sdkconfig.defaults when target is esp32s3.
# For future chip support, create sdkconfig.defaults.esp32p4 etc. alongside this file.

# ---------------------------------------------------------------------------
# Flash
# ---------------------------------------------------------------------------
CONFIG_ESPTOOLPY_FLASHSIZE_16MB=y
CONFIG_ESPTOOLPY_FLASHMODE_QIO=y

# ---------------------------------------------------------------------------
# CPU
# ---------------------------------------------------------------------------
CONFIG_ESP_DEFAULT_CPU_FREQ_MHZ_240=y

# ---------------------------------------------------------------------------
# PSRAM — Octal SPI RAM (8 MB on CUBE32-S3 Core)
# ---------------------------------------------------------------------------
CONFIG_SPIRAM=y
CONFIG_SPIRAM_MODE_OCT=y
CONFIG_SPIRAM_SPEED_80M=y
CONFIG_SPIRAM_MALLOC_ALWAYSINTERNAL=512
CONFIG_SPIRAM_MALLOC_RESERVE_INTERNAL=65536
CONFIG_SPIRAM_MEMTEST=n

# ---------------------------------------------------------------------------
# Cache — larger instruction cache improves PSRAM throughput
# ---------------------------------------------------------------------------
CONFIG_ESP32S3_INSTRUCTION_CACHE_32KB=y
CONFIG_ESP32S3_DATA_CACHE_LINE_64B=y

# ---------------------------------------------------------------------------
# MbedTLS — allocate buffers in external PSRAM
# ---------------------------------------------------------------------------
CONFIG_MBEDTLS_EXTERNAL_MEM_ALLOC=y
CONFIG_MBEDTLS_DYNAMIC_FREE_CONFIG_DATA=y

# ---------------------------------------------------------------------------
# WiFi — further reduce internal RAM usage (SPIRAM available for buffers)
# ---------------------------------------------------------------------------
CONFIG_ESP_WIFI_STATIC_RX_BUFFER_NUM=3
CONFIG_ESP_WIFI_DYNAMIC_RX_BUFFER_NUM=6
CONFIG_ESP_WIFI_RX_BA_WIN=3
CONFIG_LWIP_TCPIP_RECVMBOX_SIZE=16

# ---------------------------------------------------------------------------
# System event task — reduce stack (less contention with LVGL + audio tasks)
# ---------------------------------------------------------------------------
CONFIG_ESP_SYSTEM_EVENT_TASK_STACK_SIZE=4096
```
