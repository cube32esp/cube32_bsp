## examples/hello_lvgl/sdkconfig.defaults
```kconfig
# CUBE32 sdkconfig.defaults -- hello_lvgl

# Compiler
CONFIG_COMPILER_OPTIMIZATION_SIZE=y
CONFIG_COMPILER_CXX_EXCEPTIONS=y
CONFIG_COMPILER_CXX_EXCEPTIONS_EMG_POOL_SIZE=1024
CONFIG_COMPILER_CXX_RTTI=y

# Bootloader
CONFIG_BOOTLOADER_COMPILER_OPTIMIZATION_PERF=y
CONFIG_BOOTLOADER_LOG_LEVEL_NONE=y
CONFIG_BOOTLOADER_SKIP_VALIDATE_ALWAYS=y
CONFIG_BOOTLOADER_APP_ROLLBACK_ENABLE=y

# Partition table
CONFIG_PARTITION_TABLE_CUSTOM=y
CONFIG_PARTITION_TABLE_CUSTOM_FILENAME="partitions/partitions.csv"
CONFIG_PARTITION_TABLE_OFFSET=0x8000

# FreeRTOS
CONFIG_ESP_TASK_WDT_TIMEOUT_S=10
CONFIG_FREERTOS_GENERATE_RUN_TIME_STATS=y
CONFIG_FREERTOS_USE_STATS_FORMATTING_FUNCTIONS=y
CONFIG_ESP_MAIN_TASK_STACK_SIZE=8192

# Newlib and UART
CONFIG_NEWLIB_NANO_FORMAT=y
CONFIG_UART_ISR_IN_IRAM=y

# CUBE32 board and subsystems
CONFIG_CUBE32_BOARD_S3_CORE=y
CONFIG_CUBE32_DISPLAY_ENABLED=y
CONFIG_CUBE32_LVGL_ENABLED=y
CONFIG_CUBE32_TOUCH_ENABLED=y
CONFIG_CUBE32_IMU_ENABLED=n
CONFIG_CUBE32_MAG_ENABLED=n
CONFIG_CUBE32_AUDIO_ENABLED=n
CONFIG_CUBE32_SDCARD_ENABLED=n
CONFIG_CUBE32_CAMERA_ENABLED=n
CONFIG_CUBE32_MODEM_ENABLED=n
CONFIG_CUBE32_PMU_ENABLED=y
CONFIG_CUBE32_BLE_OTA_ENABLED=y
CONFIG_CUBE32_RTC_ENABLED=y
CONFIG_CUBE32_ADC_BUTTON_ENABLED=n

# Bluetooth -- NimBLE is required by CUBE32 BLE OTA
CONFIG_BT_ENABLED=y
CONFIG_BT_NIMBLE_ENABLED=y
CONFIG_BT_NIMBLE_ROLE_PERIPHERAL=y
CONFIG_BT_NIMBLE_ROLE_BROADCASTER=y
CONFIG_BT_NIMBLE_MAX_CONNECTIONS=1
CONFIG_BT_NIMBLE_ATT_PREFERRED_MTU=512
CONFIG_BT_NIMBLE_TRANSPORT_ACL_SIZE=512
CONFIG_BT_NIMBLE_MSYS_1_BLOCK_COUNT=24
CONFIG_BT_NIMBLE_MSYS_2_BLOCK_COUNT=32

# LVGL 9.x
CONFIG_LV_USE_CLIB_MALLOC=y
CONFIG_LV_USE_CLIB_STRING=y
CONFIG_LV_USE_CLIB_SPRINTF=y
CONFIG_LV_FONT_MONTSERRAT_10=y
CONFIG_LV_FONT_MONTSERRAT_14=y
CONFIG_LV_FONT_MONTSERRAT_20=y
CONFIG_LV_FONT_MONTSERRAT_24=y
```
